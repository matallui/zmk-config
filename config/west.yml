## config/west.yml
```yaml
manifest:
  remotes:
    - name: zmkfirmware
      url-base: https://github.com/zmkfirmware
  projects:
    - name: zmk
      remote: zmkfirmware
      revision: 461f5c832fb8854d87dca54d113d306323697219
      import: app/west.yml
  self:
    path: config
```
